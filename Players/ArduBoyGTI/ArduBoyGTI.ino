// Arduboy GTI player
// NOTE! You must add the following lines to your library for this to compile:
// arduboy.h: uint8_t getCursorX(); uint8_t getCursorY();
// arduboy.cpp: uint8_t Arduboy::getCursorX() { return cursor_x; } uint8_t Arduboy::getCursorY() { return cursor_y; }
// replace char gti[]  with your compiled game bytecode by using compiler.py and bin2array.py -- it is currently silence.bin now
 
#include <SPI.h>
#include <EEPROM.h>
#include "Arduboy.h"
#include <avr/pgmspace.h>
Arduboy display;

#define FIRE_BUTTON 1
#define JUMP_BUTTON 2
#define RIGHT 4
#define DOWN 64
#define UP 16
#define LEFT 32

uint8_t state = 0;
uint16_t room = 0;
uint8_t inst = 0;
uint8_t col = 0;
uint8_t row = 0;
uint8_t sound = 1;
uint8_t effect = 0;

extern const unsigned char arduino[];

PROGMEM const unsigned char arduino [] = {
0x3F, 0xFF, 0xFF, 0xFC, 0x40, 0x00, 0x00, 0x02, 0x89, 0x99, 0x54, 0x91, 0x95, 0x55, 0x56, 0xA9,
0x9D, 0x95, 0x55, 0xA9, 0x95, 0x59, 0xD4, 0x91, 0x40, 0x00, 0x00, 0x02, 0x3F, 0xFF, 0xFF, 0xFC
};

// Bytecode from compiler goes here :

const unsigned char gti[] PROGMEM = { 
255,255,16,66,79,79,77,33,32,82,85,77,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132,};

// ^^^^^^^^^^^^^^^^^^^^

unsigned char exita[80] = "";
unsigned char exitb[80] = "";


void setup() {
  SPI.begin();
  display.start();
  display.clearDisplay();
  showIntro();
  display.clearDisplay();
  display.display();
}

void loop() {
startVM(0);
}

void showIntro()
{
   for(int i=-8; i<28; i=i+2) {
    display.clearDisplay();
    display.drawSlowXYBitmap(46,i, arduino, 32,8,1);
    display.display();
    delay(1000/30);
  }  if(sound == 1) { 
   display.tunes.tone(987, 160);
    delay(160);
   display.tunes.tone(1318, 400);
   delay(2000);
  }
}

/*
void showMenu(uint8_t selector) { 
  display.clearDisplay();
    display.setCursor(0,0);
  display.println("GTI VM\n\n");
  if(selector == 0) { display.println("> Start\n  Settings"); } 
  if(selector == 1) { display.println("  Start\n> Settings"); } 
  display.display(); 
  delay(1000/30);
  if(display.pressed(UP) || display.pressed(DOWN)) { 
      display.tunes.tone(300, 50);
      if(state == 0) { state = 1; } else { state = 0; } 
      while(display.pressed(UP) || display.pressed(DOWN)) { } 
    } 
  if(display.pressed(FIRE_BUTTON) || display.pressed(JUMP_BUTTON)) { if(selector == 0) { state = 2; } if(selector == 1) { state = 3; } } 
} 
*/

void startVM(uint16_t pc) {
  while(1) {  
  uint16_t type = pgm_read_byte_near(&(gti[pc])) << 8 | pgm_read_byte_near(&(gti[pc+1])) & 0xFF;
  pc++; 
  col = 0;
  if(type == 65535) { 
     pc++;
     uint8_t mode = pgm_read_byte_near(&(gti[pc])); 

     switch (mode) { 
       case 0:   // game over 
           while(1) { 
             pc++;
             uint8_t buff = pgm_read_byte_near(&(gti[pc]));
             if(buff == 0) { break; } 
             printer(pgm_read_byte_near(&(gti[pc])));
           }
           display.print("*GAME OVER*");
           anykey(); col = 0;
           return;
           break;
       case 5:   // jump
           pc++;
           pc = pgm_read_byte_near(&(gti[pc])) << 8 | pgm_read_byte_near(&(gti[pc+1])) & 0xFF;
           
           break;
       case 13:  // sfx library
            pc++;
            effect = pgm_read_byte_near(&(gti[pc]));
            switch(effect) { 
               case 0:   // rumble
                   for(int x = 60; x < 150; x++) { 
                   display.tunes.tone(x, 10);  delay(10); }
                   break;
               case 1: 
                   for(int x = 0; x < 100; x++) { 
                     if(random(0,10) == 1) { display.fillScreen(WHITE); display.display();  } else { display.fillScreen(BLACK); display.display(); } 
                   }
                   break;
            }  pc++;
            break;
       case 16:  // text page
           while(1) { 
             pc++;
             uint8_t buff = pgm_read_byte_near(&(gti[pc]));
             /*
                         if(buff == 32) {      // seek ahead for wrapping -- extremely redundant, but we have to do it
                uint8_t z = 1;
                while(1) { 
                   if(pgm_read_byte_near(&(gti[pc+z])) == 32) { 
                       if((z + col) > 19) { display.fillRect(display.getCursorX(),display.getCursorY(),8,8,BLACK);  display.print("\n"); col = 0; display.display(); break; }   
                       else { break; } 
                   }
                   if(pgm_read_byte_near(&(gti[pc+z])) == 0) { 
                       if((z + col) > 19) { display.fillRect(display.getCursorX(),display.getCursorY(),8,8,BLACK);  display.print("\n"); col = 0; display.display(); break; }   
                   }  else { break; }                  
                  z++;
                }
              } */
             
             
             if(buff == 0) { break; } 
             printer(pgm_read_byte_near(&(gti[pc])));
           }         
           anykey(); pc++;
           break;  
  }
  }
  else { 
      pc++;
      uint16_t alterexit = pgm_read_byte_near(&(gti[pc])) << 8 | pgm_read_byte_near(&(gti[pc+1])) & 0xFF; 
      pc++; pc++;
      int i = 0;
      while(1 == 1) { 
        uint8_t buff = pgm_read_byte_near(&(gti[pc]));
        if(buff == 0) { exita[i] = 0; break; }
        exita[i] = buff; Serial.print((char)exita[i]);
        i++; pc++;
      }
      pc++;
      i = 0;
      while(1 == 1) { 
        uint8_t buff = pgm_read_byte_near(&(gti[pc]));
        if(buff == 0) { exitb[i] = 0; break; }
        exitb[i] = buff; Serial.print((char)exitb[i]);
        i++; pc++;
      } int x = 0;
 
      
      while(1) { 
             pc++;
             uint8_t buff = pgm_read_byte_near(&(gti[pc]));
             if(buff == 0) { break; }  /*
             if(buff == 32) {      // seek ahead for wrapping -- extremely redundant, but we have to do it
                uint8_t z = 1;
                while(1) { 
                   if(pgm_read_byte_near(&(gti[pc+z])) == 32) { 
                       if((z + col) > 21) { display.fillRect(display.getCursorX(),display.getCursorY(),8,8,BLACK);  display.print("\n"); col = 0; display.display(); break; }   
                       else { break; } 
                   }
                   if(pgm_read_byte_near(&(gti[pc+z])) == 0) { 
                       if((z + col) > 21) { display.fillRect(display.getCursorX(),display.getCursorY(),8,8,BLACK);  display.print("\n"); col = 0; display.display(); break; }   
                   }  else { break; }                  
                  z++;
                }
              } */
             
             printer(pgm_read_byte_near(&(gti[pc])));
      }  
      pc++; 
      if(sound == 1) { display.tunes.tone(1318, 50); }
      display.fillRect(display.getCursorX(),display.getCursorY(),8,8,BLACK); display.display();
      if(display.getCursorY() < 40) { display.print("\n"); } 
      
      display.print("\nA] ");  display.display();  col=3; 
       x = 0;
       while(1) { 
             if(exita[x] == 0) { break; } 
             printer(exita[x]);
             x++; 
      }  
      x = 0; 
      if(sound == 1) { display.tunes.tone(1318, 50); }
      display.fillRect(display.getCursorX(),display.getCursorY(),8,8,BLACK); display.display();
      display.print("\nB] ");  display.display(); col=3;
       while(1) { 
             if(exitb[x] == 0) { break; } 
             printer(exitb[x]);
             x++;
      } 
      display.fillRect(display.getCursorX(),display.getCursorY(),8,8,BLACK); display.display();
      int selection = select();
      if(selection == 0) { pc = type; } 
      if(selection == 1) { pc = alterexit; } 
      display.clearDisplay();
      display.setCursor(0,0);
      display.display();
      col = 0;
  }
}
  }


void settings() { anykey(); } 

void printer(uint8_t character) { 
 col++;
 if(col > 20) {  display.fillRect(display.getCursorX(),display.getCursorY(),8,8,BLACK); display.println(); col = 0; } 
 if(character == 10) { display.fillRect(display.getCursorX(),display.getCursorY(),8,8,BLACK); col = 0; } 
 display.print((char)character);
 if(sound == 1) { display.tunes.tone(1318, 2); } 
 display.fillRect(display.getCursorX(),display.getCursorY(),8,8,WHITE); 
 display.display(); 
 delay(50);
}

uint8_t select() { 
  uint8_t c = 0; uint8_t blink = 0; if(sound == 1) { 
     display.tunes.tone(1318, 50);  delay(50);
    display.tunes.tone(400, 50); delay(50);
    display.tunes.tone(600, 50); delay(50); } 
  while(1) { 
   if(display.pressed(FIRE_BUTTON)) { return 1; } 
   if(display.pressed(JUMP_BUTTON)) { return 0; } 
   
       c++; 
    if(c > 10000) { 
       if(blink == 1) {  
         display.fillRect(120,55,10,10,WHITE); 
         display.display(); 
         blink = 0; } 
       else { 
         display.fillRect(120,55,10,10,BLACK); 
         display.display();  
         blink = 1; 
       } 
     c = 0;
   }    
   
  }
}

void anykey() { 
  display.fillRect(display.getCursorX(),display.getCursorY(),8,8,BLACK); display.display(); 
   if(sound == 1) { display.tunes.tone(600, 50);  delay(50);
    display.tunes.tone(1318, 50); delay(50);
    display.tunes.tone(900, 50); delay(50); }
    int c = 0;
    int blink = 0;  
  while(1) { 
   if(display.pressed(FIRE_BUTTON) || display.pressed(JUMP_BUTTON)) { break; } 
    c++; 
    if(c > 10000) { 
       if(blink == 1) {  
         display.fillRect(120,55,10,10,WHITE); 
         display.display(); 
         blink = 0; } 
       else { 
         display.fillRect(120,55,10,10,BLACK); 
         display.display();  
         blink = 1; 
       } 
     c = 0;
   }    
   }
  display.setCursor(0,0); display.clearDisplay(); display.display(); 
}

